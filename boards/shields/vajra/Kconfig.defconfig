## boards/shields/vajra/Kconfig.defconfig
```kconfig
if SHIELD_VAJRA_LEFT

config ZMK_KEYBOARD_NAME
    default "Vajra"

config ZMK_SPLIT_ROLE_CENTRAL
    default y

endif

if SHIELD_VAJRA_RIGHT
	config ZMK_SPLIT_ROLE_PERIPHERAL
    	bool "Peripheral side of split keyboard"
    	default y
endif
```

## boards/shields/vajra/Kconfig.shield
```kconfig
config SHIELD_VAJRA_LEFT
	def_bool $(shields_list_contains, vajra_left)

config SHIELD_VAJRA_RIGHT
	def_bool $(shields_list_contains, vajra_right)
```
